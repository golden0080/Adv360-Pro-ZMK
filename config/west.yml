## config/west.yml
```yaml
manifest:
  remotes:
    - name: zmkfirmware
      url-base: https://github.com/zmkfirmware
    - name: golden0080
      url-base: https://github.com/golden0080
  projects:
    - name: zmk
      remote: golden0080
      revision: z3.5-rebased
      import: app/west.yml
  self:
    path: config
```
